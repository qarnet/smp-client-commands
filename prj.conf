## CMakeLists.txt
```
#
# Copyright (c) 2019 Nordic Semiconductor ASA
#
# SPDX-License-Identifier: LicenseRef-Nordic-5-Clause
#
cmake_minimum_required(VERSION 3.20.0)

find_package(Zephyr REQUIRED HINTS $ENV{ZEPHYR_BASE})
project(NONE)

target_include_directories(app PRIVATE include)
FILE(GLOB app_headers include/*.h)

FILE(GLOB app_sources src/*.c src/mgmt/*.c)

# NORDIC SDK APP START
target_sources(app PRIVATE ${app_sources})
# NORDIC SDK APP END
```

## prj.conf
```kconfig
#
# Copyright (c) 2019 Nordic Semiconductor ASA
#
# SPDX-License-Identifier: LicenseRef-Nordic-5-Clause
#
CONFIG_NCS_SAMPLES_DEFAULTS=y

CONFIG_BT=y
CONFIG_BT_DEBUG_LOG=y
CONFIG_BT_CENTRAL=y
CONFIG_BT_SMP=y
CONFIG_BT_GATT_CLIENT=y
CONFIG_BT_GATT_DM=y
CONFIG_HEAP_MEM_POOL_SIZE=2048
CONFIG_BT_DFU_SMP=y

CONFIG_BT_SCAN=y
CONFIG_BT_SCAN_FILTER_ENABLE=y
CONFIG_BT_SCAN_UUID_CNT=1

CONFIG_ZCBOR=y
CONFIG_ZCBOR_STOP_ON_ERROR=y
CONFIG_ZCBOR_VERBOSE=y

CONFIG_DK_LIBRARY=y
```

## src/main.c
```c
/* main.c - Application main entry point */

/*
 * Copyright (c) 2019 Nordic Semiconductor ASA
 *
 * SPDX-License-Identifier: LicenseRef-Nordic-5-Clause
 */

#include <zephyr/types.h>
#include <stddef.h>
#include <errno.h>
#include <zephyr/kernel.h>
#include <zephyr/sys/printk.h>

#include <zcbor_encode.h>
#include <zcbor_decode.h>
#include <zcbor_common.h>

#include <zephyr/bluetooth/bluetooth.h>
#include <zephyr/bluetooth/hci.h>
#include <zephyr/bluetooth/conn.h>
#include <zephyr/bluetooth/uuid.h>
#include <zephyr/bluetooth/gatt.h>
#include <bluetooth/gatt_dm.h>
#include <zephyr/sys/byteorder.h>
#include <bluetooth/scan.h>
#include <bluetooth/services/dfu_smp.h>
#include <dk_buttons_and_leds.h>

#include "default_os_mgmt.h"

static struct bt_conn *default_conn;
struct bt_dfu_smp dfu_smp;
volatile bool currently_connected = false;

static void scan_filter_match(struct bt_scan_device_info *device_info,
			      struct bt_scan_filter_match *filter_match,
			      bool connectable)
{
	char addr[BT_ADDR_LE_STR_LEN];

	bt_addr_le_to_str(device_info->recv_info->addr, addr, sizeof(addr));

	printk("Filters matched. Address: %s connectable: %s\n",
		addr, connectable ? "yes" : "no");
}

static void scan_connecting_error(struct bt_scan_device_info *device_info)
{
	printk("Connecting failed\n");
}

static void scan_connecting(struct bt_scan_device_info *device_info,
			    struct bt_conn *conn)
{
	default_conn = bt_conn_ref(conn);
}

BT_SCAN_CB_INIT(scan_cb, scan_filter_match, NULL,
		scan_connecting_error, scan_connecting);

static void discovery_completed_cb(struct bt_gatt_dm *dm,
				   void *context)
{
	int err;

	printk("The discovery procedure succeeded\n");

	bt_gatt_dm_data_print(dm);

	err = bt_dfu_smp_handles_assign(dm, &dfu_smp);
	if (err) {
		printk("Could not init DFU SMP client object, error: %d\n",
		       err);
	}

	err = bt_gatt_dm_data_release(dm);
	if (err) {
		printk("Could not release the discovery data, error "
		       "code: %d\n", err);
	}

	currently_connected = true;
}

static void discovery_service_not_found_cb(struct bt_conn *conn,
					   void *context)
{
	printk("The service could not be found during the discovery\n");
}

static void discovery_error_found_cb(struct bt_conn *conn,
				     int err,
				     void *context)
{
	printk("The discovery procedure failed with %d\n", err);
}

static const struct bt_gatt_dm_cb discovery_cb = {
	.completed = discovery_completed_cb,
	.service_not_found = discovery_service_not_found_cb,
	.error_found = discovery_error_found_cb,
};

static void exchange_func(struct bt_conn *conn, uint8_t err,
			  struct bt_gatt_exchange_params *params)
{
	printk("MTU exchange %s\n", err == 0 ? "successful" : "failed");
	printk("Current MTU: %u\n", bt_gatt_get_mtu(conn));
}

static void connected(struct bt_conn *conn, uint8_t conn_err)
{
	char addr[BT_ADDR_LE_STR_LEN];
	int err;

	bt_addr_le_to_str(bt_conn_get_dst(conn), addr, sizeof(addr));

	if (conn_err) {
		printk("Failed to connect to %s (%u)\n", addr, conn_err);
		if (conn == default_conn) {
			bt_conn_unref(default_conn);
			default_conn = NULL;

			/* This demo doesn't require active scan */
			err = bt_scan_start(BT_SCAN_TYPE_SCAN_ACTIVE);
			if (err) {
				printk("Scanning failed to start (err %d)\n",
				       err);
			}
		}

		return;
	}

	printk("Connected: %s\n", addr);

	// if (bt_conn_set_security(conn, BT_SECURITY_L2)) {
	// 	printk("Failed to set security\n");
	// }

	// struct bt_gatt_exchange_params exchange_params;
	// exchange_params.func = exchange_func;
	// err = bt_gatt_exchange_mtu(conn, &exchange_params);
	// if (err) {
	// 	printk("MTU exchange failed (err %d)\n", err);
	// } else {
	// 	printk("MTU exchange pending\n");
	// }

	if (conn == default_conn) {
		err = bt_gatt_dm_start(conn, BT_UUID_DFU_SMP_SERVICE,
				       &discovery_cb, NULL);
		if (err) {
			printk("Could not start the discovery procedure "
			       "(err %d)\n", err);
		}
	}
}

static void disconnected(struct bt_conn *conn, uint8_t reason)
{
	char addr[BT_ADDR_LE_STR_LEN];
	int err;

	bt_addr_le_to_str(bt_conn_get_dst(conn), addr, sizeof(addr));

	printk("Disconnected: %s (reason %u)\n", addr, reason);

	currently_connected = false;

	if (default_conn != conn) {
		return;
	}

	bt_conn_unref(default_conn);
	default_conn = NULL;

	/* This demo doesn't require active scan */
	err = bt_scan_start(BT_SCAN_TYPE_SCAN_ACTIVE);
	if (err) {
		printk("Scanning failed to start (err %d)\n", err);
	}
}

static void security_changed(struct bt_conn *conn, bt_security_t level,
			     enum bt_security_err err)
{
	char addr[BT_ADDR_LE_STR_LEN];

	bt_addr_le_to_str(bt_conn_get_dst(conn), addr, sizeof(addr));

	if (!err) {
		printk("Security changed: %s level %u\n", addr, level);
	} else {
		printk("Security failed: %s level %u err %d\n", addr, level,
			err);
	}
}

BT_CONN_CB_DEFINE(conn_callbacks) = {
	.connected = connected,
	.disconnected = disconnected,
	.security_changed = security_changed
};

static void scan_init(void)
{
	int err;

	struct bt_scan_init_param scan_init = {
		.connect_if_match = 1,
		.scan_param = NULL,
		.conn_param = BT_LE_CONN_PARAM_DEFAULT
	};

	bt_scan_init(&scan_init);
	bt_scan_cb_register(&scan_cb);

	err = bt_scan_filter_add(BT_SCAN_FILTER_TYPE_UUID,
				 BT_UUID_DFU_SMP_SERVICE);
	if (err) {
		printk("Scanning filters cannot be set (err %d)\n", err);

		return;
	}

	err = bt_scan_filter_enable(BT_SCAN_UUID_FILTER, false);
	if (err) {
		printk("Filters cannot be turned on (err %d)\n", err);
	}
}


static void dfu_smp_on_error(struct bt_dfu_smp *dfu_smp, int err)
{
	printk("DFU SMP generic error: %d\n", err);
}


static const struct bt_dfu_smp_init_params init_params = {
	.error_cb = dfu_smp_on_error
};

int main(void)
{

	int err;

	k_msleep(1000);

	printk("Starting Bluetooth Central SMP Client example\n");

	bt_dfu_smp_init(&dfu_smp, &init_params);

	err = bt_enable(NULL);
	if (err) {
		printk("Bluetooth init failed (err %d)\n", err);
		return 0;
	}

	printk("Bluetooth initialized\n");

	scan_init();

	err = bt_scan_start(BT_SCAN_TYPE_SCAN_ACTIVE);
	if (err) {
		printk("Scanning failed to start (err %d)\n", err);
		return 0;
	}

	printk("Scanning successfully started\n");
	
	while(true)
	{
		k_msleep(1000);
		if(currently_connected)
		{
			// smp_echo(&dfu_smp);
			// k_msleep(1000);
			// smp_task_stats(&dfu_smp);
			// k_msleep(1000);
			// smp_mem_pool_stats(&dfu_smp);
			// k_msleep(1000);
			// smp_mcumgr_params(&dfu_smp);
			// k_msleep(1000);
			// smp_bootloader_info(&dfu_smp);
			// k_msleep(1000);
			// smp_sys_reset(&dfu_smp);
			return;
		}
	}

	return 0;
}
```

## include/app_sw_img_mgmt.h
```c
#ifndef _APP_SW_IMG_MGMT_H_
#define _APP_SW_IMG_MGMT_H_

#include "smp_internal.h"

#define DATA_CHUNK_SIZE 128

struct img_data
{
    int8_t image; // Should only be present, when "off" 0. Assumed 0
    int32_t len; // Optional length of an image. Must appear when "off" is 0
    int32_t off;
    uint8_t sha[16]; // Should only be present, when "off" 0. Optional        . Of full image
    uint8_t data[128];
    uint8_t upgrade; // Optional, sets that only upgrades allowed
};
volatile struct img_data img_data_obj = 
{
    .image = -1,
    .len = 0,
    .off = 0,
    .upgrade = -1,
    .sha = {0xff, 0xff, 0xff}
};

struct smp_state_of_images_rsp 
{
    uint32_t image;
    uint32_t slot;
    char version[25];
    uint8_t hash[32];
    bool bootable;
    bool pending;
    bool confirmed;
    bool active;
    bool permanent;
};
int smp_get_state_of_images(struct bt_dfu_smp *dfu_smp, struct smp_state_of_images_rsp *response);
int smp_set_state_of_images(struct bt_dfu_smp *dfu_smp, struct smp_state_of_images_rsp *response, uint8_t *hash, bool confirm);

struct smp_image_upload_rsp 
{
    char *echo_string;
};
int smp_image_upload(struct bt_dfu_smp *dfu_smp, struct smp_image_upload_rsp *response, struct img_data *data);

struct smp_image_erase_rsp 
{
    char *echo_string;
};
int smp_image_erase(struct bt_dfu_smp *dfu_smp, struct smp_image_erase_rsp *response, uint32_t slot);

union app_sw_img_rsp
{   
    struct smp_get_state_of_images_rsp get_state_of_images;
    struct smp_set_state_of_images_rsp set_state_of_images;
    struct smp_image_upload_rsp image_upload;
    struct smp_image_erase_rsp image_erase;
} full_app_sw_img_rsp;

#endif
```

## include/default_os_mgmt.h
```c
#ifndef _DEFAULT_OS_MGMT_H_
#define _DEFAULT_OS_MGMT_H_


#include "default_os_mgmt.h"
#include "smp_internal.h"

struct smp_echo_rsp 
{
    char *echo_string;
};
int smp_echo(struct bt_dfu_smp *dfu_smp, struct smp_echo_rsp *response);

struct smp_task_stats_rsp 
{

};
int smp_task_stats(struct bt_dfu_smp *dfu_smp, struct smp_task_stats_rsp *response);

struct smp_mem_pool_stats_rsp 
{

};
int smp_mem_pool_stats(struct bt_dfu_smp *dfu_smp, struct smp_mem_pool_stats_rsp *response);

struct smp_sys_reset_rsp 
{

};
int smp_sys_reset(struct bt_dfu_smp *dfu_smp, struct smp_sys_reset_rsp *response);

struct smp_mcumgr_params_rsp 
{
    uint32_t buf_size;
    uint32_t buf_count;
};
int smp_mcumgr_params(struct bt_dfu_smp *dfu_smp, struct smp_mcumgr_params_rsp *response);

struct smp_info_rsp 
{

};
int smp_info(struct bt_dfu_smp *dfu_smp, struct smp_info_rsp *response);

struct smp_bootloader_info_rsp 
{
    char str_rsp[50];
};
int smp_bootloader_info(struct bt_dfu_smp *dfu_smp, struct smp_bootloader_info_rsp *response);


#endif
```

## include/file_mgmt.h
```c
#ifndef _FILE_MGMT_H_
#define _FILE_MGMT_H_

#endif
```

## include/settings_mgmt.h
```c
#ifndef _SETTINGS_MGMT_H_
#define _SETTINGS_MGMT_H_


#endif
```

## include/shell_mgmt.h
```c
#ifndef _SHELL_MGMT_H_
#define _SHELL_MGMT_H_

#endif
```

## include/smp_commands.h
```c
#ifndef _SMP_COMMANDS_H_
#define _SMP_COMMANDS_H_

#include <zephyr/types.h>
#include <stddef.h>
#include <errno.h>
#include <zephyr/kernel.h>
#include <zephyr/sys/printk.h>

#include <zcbor_encode.h>
#include <zcbor_decode.h>
#include <zcbor_common.h>

#include <zephyr/bluetooth/bluetooth.h>
#include <zephyr/bluetooth/hci.h>
#include <zephyr/bluetooth/conn.h>
#include <zephyr/bluetooth/uuid.h>
#include <zephyr/bluetooth/gatt.h>
#include <bluetooth/gatt_dm.h>
#include <zephyr/sys/byteorder.h>
#include <bluetooth/scan.h>
#include <bluetooth/services/dfu_smp.h>
#include <dk_buttons_and_leds.h>

#include <zephyr/device.h>

// #include <pm_config.h>

#endif
```

## include/smp_commands_internal.h
```c
#ifndef _SMP_COMMANDS_INTERNAL_H_
#define _SMP_COMMANDS_INTERNAL_H_

typedef enum
{
    SMP_OID_READ = 0,
    SMP_OID_READ_RESPONSE = 1,
    SMP_OID_WRITE = 2,
    SMP_OID_WRITE_RESPONSE = 3
} smp_op_id_t;

typedef enum 
{
    SMP_GID_OS = 0,
    SMP_GID_APP_SOFTWARE_IMG = 1,
    SMP_GID_STATS = 2,
    SMP_GID_SETTINGS = 3,
    SMP_GID_APP_SYS_LOG = 4,
    SMP_GID_RUN_TIME_TESTS = 5,
    SMP_GID_SPLIT_IMG = 6,
    SMP_GID_TEST_CRASH = 7,
    SMP_GID_FILE = 8,
    SMP_GID_SHELL = 9,
    SMP_GID_ZEPHYR = 63,
    SMP_GID_BASE = 64
} smp_management_group_id_t;

typedef enum
{
    SMP_CID_OS_ECHO = 0,
    SMP_CID_OS_CONSOLE = 1,
    SMP_CID_OS_TASK_STAT = 2,
    SMP_CID_OS_MEM_POOL_STAT = 3,
    SMP_CID_OS_DATE_TIME = 4,
    SMP_CID_OS_RESET = 5,
    SMP_CID_OS_MCUMGR_PARAMS = 6,
    SMP_CID_OS_INFO = 7,
    SMP_CID_OS_BOOTLOADER_INFO = 8
} smp_os_command_id_t;

typedef enum
{
    SMP_CID_APP_IMG_STATE = 0,
    SMP_CID_APP_IMG_UPLOAD = 1,
    SMP_CID_APP_IMG_FILE = 2,
    SMP_CID_APP_IMG_CORELIST = 3,
    SMP_CID_APP_IMG_CORELOAD = 4,
    SMP_CID_APP_IMG_ERASE = 5
} smp_app_image_command_id_t;

typedef enum
{
    SMP_CID_STATS_GROUP_DATA = 0,
    SMP_CID_STATS_LIST_GROUPS = 1
} smp_stat_command_id_t;

typedef enum
{
    SMP_CID_SETTINGS_READ_WRITE = 0,
    SMP_CID_SETTINGS_DELETE = 1,
    SMP_CID_SETTINGS_COMMIT = 2,
    SMP_CID_SETTINGS_LOAD_SAVE = 3    
} smp_settings_command_id_t;

typedef enum
{
    SMP_CID_FILE_DOWNLOAD = 0,
    SMP_CID_FILE_STATUS = 1,
    SMP_CID_FILE_HASH_CHCKSUM = 2,
    SMP_CID_FILE_SUPPORTED_FILE_HASH_CHKSUM = 3,
    SMP_CID_FILE_CLOSE = 4
} smp_file_command_id_t;

typedef enum
{
    SMP_CID_SHELL_EXECUTE = 0
} smp_shell_command_id_t;

#endif
```

## include/smp_internal.h
```c
#ifndef _SMP_INTERNAL_H_
#define _SMP_INTERNAL_H_

#include <zephyr/types.h>
#include <stddef.h>
#include <errno.h>
#include <zephyr/kernel.h>
#include <zephyr/sys/printk.h>

#include <zcbor_encode.h>
#include <zcbor_decode.h>
#include <zcbor_common.h>

#include <zephyr/bluetooth/bluetooth.h>
#include <zephyr/bluetooth/hci.h>
#include <zephyr/bluetooth/conn.h>
#include <zephyr/bluetooth/uuid.h>
#include <zephyr/bluetooth/gatt.h>
#include <bluetooth/gatt_dm.h>
#include <zephyr/sys/byteorder.h>
#include <bluetooth/scan.h>
#include <bluetooth/services/dfu_smp.h>
#include <dk_buttons_and_leds.h>

#include <zephyr/device.h>

struct smp_buffer {
	struct bt_dfu_smp_header header;
	uint8_t payload[300];
};

#endif
```

## include/stats_mgmt.h
```c
#ifndef _STATS_MGMT_H_
#define _STATS_MGMT_H_


#endif
```

## include/test_smp.h
```c
#fndef TEST_SMP_H_
#
```

## src/smp_commands.h
```c
#ifndef _SMP_COMMANDS_H_
#define _SMP_COMMANDS_H_

#include <zephyr/types.h>
#include <stddef.h>
#include <errno.h>
#include <zephyr/kernel.h>
#include <zephyr/sys/printk.h>

#include <zcbor_encode.h>
#include <zcbor_decode.h>
#include <zcbor_common.h>

#include <zephyr/bluetooth/bluetooth.h>
#include <zephyr/bluetooth/hci.h>
#include <zephyr/bluetooth/conn.h>
#include <zephyr/bluetooth/uuid.h>
#include <zephyr/bluetooth/gatt.h>
#include <bluetooth/gatt_dm.h>
#include <zephyr/sys/byteorder.h>
#include <bluetooth/scan.h>
#include <bluetooth/services/dfu_smp.h>
#include <dk_buttons_and_leds.h>

#include <zephyr/device.h>
#include <zephyr/drivers/flash.h>

#include <pm_config.h>

#endif
```
